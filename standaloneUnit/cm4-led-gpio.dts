/*
 * Device Tree overlay: repurpose USART4's RTS pin (RTS4) as a plain GPIO
 * output, for the Standalone unit's status LED.
 *
 * Per audioCapture/StandaloneDataCollection.md, the illuminated power switch's LED is wired
 * between the 3V3 pin on UART0/1 (fixed high) and RTS4 — this overlay mux's
 * RTS4 out of UART flow-control mode into plain GPIO output mode so
 * StatusLed (src/aircraftAudio/standalone/statusLed.py) can drive it. Same
 * pattern as cm4-sdspi.dts (this directory), which repurposes GPIO18-21 from
 * their default function for the SD-over-SPI socket.
 *
 * The LED's polarity (active-low, since one leg is a fixed 3.3V rail) is
 * handled in software via gpiod's LineSettings(active_low=True) in
 * StatusLed, not here — this overlay only concerns pin muxing, not
 * electrical polarity.
 *
 * RTS4 is BCM GPIO11 on the Ochin baseboard, matching StatusLed's
 * --ledLine default.
 *
 * Compile and install (same as cm4-sdspi.dts):
 *   sudo apt install -y device-tree-compiler
 *   dtc -@ -I dts -O dtb -o cm4-led-gpio.dtbo cm4-led-gpio.dts
 *   sudo install -m 0644 cm4-led-gpio.dtbo /boot/firmware/overlays/cm4-led-gpio.dtbo
 * Enable by adding to /boot/firmware/config.txt:
 *   dtoverlay=cm4-led-gpio
 */

/dts-v1/;
/plugin/;

/ {
    compatible = "brcm,bcm2711";

    fragment@0 {
        target = <&gpio>;
        __overlay__ {
            led_gpio_pins: led_gpio_pins {
                brcm,pins = <11>;        /* RTS4 (USART4) */
                brcm,function = <1>;     /* 1 = GPIO output */
            };
        };
    };
};
